## drivers/net/wireless/ath/wil6210/Kconfig.rej
```kconfig
--- drivers/net/wireless/ath/wil6210/Kconfig
+++ drivers/net/wireless/ath/wil6210/Kconfig
@@ -1,7 +1,6 @@
 config WIL6210
 	tristate "Wilocity 60g WiFi card wil6210 support"
 	select WANT_DEV_COREDUMP
-	select CRC32
 	depends on CFG80211
 	depends on PCI
 	default n
```

## drivers/net/wireless/mediatek/mt7612u/Kconfig
```kconfig
config MT7612U
	tristate "Mediatek/Ralink MT7612U/MT7632U/MT7662U USB Wi-Fi driver"
	depends on USB
	---help---
	  From git://github.com/ulli-kroll/mt7612u.git master
```

## drivers/net/wireless/realtek/rtl8192du/Kconfig
```kconfig
config RTL8192DU
	tristate "Realtek 8192DU USB WiFi"
	depends on USB
	help
	  Help message of RTL8192DU
```

## drivers/net/wireless/realtek/rtl8723au/Kconfig
```kconfig
config RTL8723AU
	tristate "Realtek 8723AU USB WiFi"
	depends on USB
	help
	  Help message of RTL8723AU
```
